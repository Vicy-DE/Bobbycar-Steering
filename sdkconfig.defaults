## sdkconfig.defaults
```kconfig
# Common defaults for all ESP32 targets
CONFIG_ESPTOOLPY_FLASHSIZE_4MB=y
CONFIG_PARTITION_TABLE_CUSTOM=y
CONFIG_PARTITION_TABLE_CUSTOM_FILENAME="partitions.csv"
CONFIG_FREERTOS_HZ=1000
CONFIG_ESP_SYSTEM_PANIC_PRINT_HALT=y
CONFIG_LOG_DEFAULT_LEVEL_INFO=y
CONFIG_LOG_MAXIMUM_LEVEL_DEBUG=y

# LVGL
CONFIG_LV_COLOR_DEPTH_16=y
CONFIG_LV_FONT_MONTSERRAT_14=y
CONFIG_LV_FONT_MONTSERRAT_24=y
CONFIG_LV_USE_LABEL=y
CONFIG_LV_USE_BAR=y

# Bluetooth — Bluepad32 + BTstack
CONFIG_BT_ENABLED=y
CONFIG_BT_CONTROLLER_ONLY=y

# Bluepad32
CONFIG_BLUEPAD32_PLATFORM_CUSTOM=y
CONFIG_BLUEPAD32_MAX_DEVICES=4
CONFIG_BLUEPAD32_USB_CONSOLE_ENABLE=n

# BTstack
CONFIG_BTSTACK_AUDIO=n

# FreeRTOS — enable stats
CONFIG_FREERTOS_USE_TRACE_FACILITY=y
CONFIG_FREERTOS_USE_STATS_FORMATTING_FUNCTIONS=y
```
